## firmware/buildroot/configs/earbrain_defconfig
```kconfig
# Buildroot defconfig for Ear-Brain RK3576 board
BR2_aarch64=y
BR2_cortex_a72_a53=y

# System
BR2_TOOLCHAIN_BUILDROOT_MUSL=y
BR2_TOOLCHAIN_BUILDROOT_CXX=y
BR2_ROOTFS_DEVICE_CREATION_DYNAMIC_MDEV=y
BR2_INIT_BUSYBOX=y
BR2_PACKAGE_BUSYBOX_SHOW_OTHERS=y

# Kernel (stripped PREEMPT_RT for audio)
BR2_LINUX_KERNEL=y
BR2_LINUX_KERNEL_CUSTOM_VERSION=y
BR2_LINUX_KERNEL_CUSTOM_VERSION_VALUE="6.1.75"
BR2_LINUX_KERNEL_DEFCONFIG="earbrain"
BR2_LINUX_KERNEL_DTS_SUPPORT=y
BR2_LINUX_KERNEL_INTREE_DTS_NAME="rockchip/rk3576-earbrain"
BR2_LINUX_KERNEL_NEEDS_HOST_OPENSSL=y

# Audio (ALSA)
BR2_PACKAGE_ALSA_LIB=y
BR2_PACKAGE_ALSA_UTILS=y
BR2_PACKAGE_ALSA_UTILS_AMIXER=y
BR2_PACKAGE_ALSA_UTILS_APLAY=y

# Storage & Encryption
BR2_PACKAGE_SQLCIPHER=y
BR2_PACKAGE_E2FSPROGS=y

# Bluetooth (BlueZ)
BR2_PACKAGE_BLUEZ5_UTILS=y
BR2_PACKAGE_BLUEZ5_UTILS_GATTTOOL=y
BR2_PACKAGE_DBUS=y

# Custom Packages
BR2_PACKAGE_ORBITD=y

# Root filesystem
BR2_TARGET_ROOTFS_EXT2=y
BR2_TARGET_ROOTFS_EXT2_4=y
BR2_TARGET_ROOTFS_EXT2_SIZE="1G"
# Disable tar rootfs to save build time
BR2_TARGET_ROOTFS_TAR=n

# Board specific overlay
BR2_ROOTFS_OVERLAY="board/earbrain/overlay"
```

## firmware/buildroot/package/orbitd/Config.in
```kconfig
config BR2_PACKAGE_ORBITD
	bool "orbitd"
	depends on BR2_TOOLCHAIN_HAS_THREADS
	depends on BR2_INSTALL_LIBSTDCPP
	select BR2_PACKAGE_ALSA_LIB
	select BR2_PACKAGE_BLUEZ5_UTILS
	select BR2_PACKAGE_SQLCIPHER
	help
	  Ear-Brain core daemon for embedded audio intelligence.
```
